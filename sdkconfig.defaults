## sdkconfig.defaults
```kconfig
CONFIG_IDF_TARGET="esp32s3"
CONFIG_IDF_TARGET_ESP32S3=y

# SPI Flash
CONFIG_ESPTOOLPY_FLASHSIZE_4MB=y
CONFIG_PARTITION_TABLE_SINGLE_APP_LARGE=y

# PSRAM：本板未焊接 PSRAM 芯片，必须关闭，否则启动时 abort
# CONFIG_SPIRAM is not set

# WiFi
CONFIG_ESP_WIFI_ENABLED=y

# LVGL 字体
CONFIG_LV_FONT_MONTSERRAT_10=y
CONFIG_LV_FONT_MONTSERRAT_12=y
CONFIG_LV_FONT_MONTSERRAT_14=y
CONFIG_LV_FONT_MONTSERRAT_18=y
CONFIG_LV_FONT_MONTSERRAT_32=y
# 中文字体：用自定义小字体 font_cn_18.c（28KB，仅含所需汉字）
# 不启用内置 CJK 字体（300KB 太大）
# CONFIG_LV_FONT_SOURCE_HAN_SANS_SC_16_CJK is not set
# 默认字体设为 montserrat_14
CONFIG_LV_FONT_DEFAULT_MONTSERRAT_14=y

# FreeRTOS
CONFIG_FREERTOS_HZ=1000

# ESP HTTP Client
CONFIG_ESP_HTTP_CLIENT_ENABLE_HTTPS=n
```
